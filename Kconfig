## Kconfig
```kconfig
menu "Conductor custom behaviors"

config ZMK_BEHAVIOR_SMART_HOLD_TRIGGER
    bool "Enable smart hold trigger behavior"
    default y

endmenu
```

## dts/bindings/behaviors/zmk,behavior-smart-hold-trigger.yaml
```yaml
description: Smart hold + trigger behavior

compatible: "zmk,behavior-smart-hold-trigger"

include: two_param.yaml

properties:
  wait-time-ms:
    type: int
    required: false
    default: 700
```
